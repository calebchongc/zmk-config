## boards/shields/cosmotyl/Kconfig.shield
```kconfig
# No whitespace after the comma or in your part name!
config SHIELD_COSMOTYL_LEFT
    def_bool $(shields_list_contains,cosmotyl_left)

# No whitespace after the comma or in your part name!
config SHIELD_COSMOTYL_RIGHT
    def_bool $(shields_list_contains,cosmotyl_right)
```
